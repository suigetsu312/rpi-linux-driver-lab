
/dts-v1/;
/plugin/;

/ {
    fragment@0 {
        target = <&spi0>;

        __overlay__ {
	    #address-cells= <1>;
	    #size-cells= <0>;
            status = "okay";

            /*
             * Reuse the existing SPI0 CS0 device node.
             * Replace spidev with our LCD device.
             */
            spidev@0 {
                compatible = "learning,ili9341-lcd";
                reg = <0>;

                spi-max-frequency = <8000000>;

                dc-gpios = <&gpio 22 0>;
                reset-gpios = <&gpio 23 1>;

                status = "okay";
            };
        };
    };
};
